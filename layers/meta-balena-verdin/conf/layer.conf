## layers/meta-balena-verdin/conf/layer.conf
```bitbake
BBPATH .= ":${LAYERDIR}"

BBFILES += "${LAYERDIR}/recipes-*/*/*.bb \
            ${LAYERDIR}/recipes-*/*/*.bbappend"

BBFILE_COLLECTIONS += "balena-toradex-verdin"
BBFILE_PATTERN_balena-toradex-verdin := "^${LAYERDIR}/"
BBFILE_PRIORITY_balena-toradex-verdin = "1337"

LAYERSERIES_COMPAT_balena-toradex-verdin = "kirkstone"
```
